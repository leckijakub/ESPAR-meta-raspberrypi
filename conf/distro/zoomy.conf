## conf/distro/zoomy.conf
```bitbake
require conf/distro/poky.conf

DISTRO = "zoomy"

DISTRO_FEATURES:append = " systemd"
VIRTUAL-RUNTIME:init_manager = "systemd"
DISTRO_FEATURES:BACKFILL_CONSIDERED = "sysvinit"
VIRTUAL-RUNTIME:initscripts = ""

POKY_INIT_MANAGER = "systemd"

ENABLE_UART = "1"
DISABLE_VC4GRAPHICS = "1"
BOOT_DELAY = "0"
CMDLINE_DEBUG = "loglevel=3"
KERNEL_MODULE_AUTOLOAD += "usbip-core usbip-host"

DISTRO_EXTRA_RDEPENDS += "minicom usbip-server"
```

## conf/machine/raspberrypi0.conf
```bitbake
#@TYPE: Machine
#@NAME: RaspberryPi Zero Development Board
#@DESCRIPTION: Machine configuration for the RaspberryPi Zero board (https://www.raspberrypi.org/blog/raspberry-pi-zero)

MACHINEOVERRIDES =. "raspberrypi:"
include conf/machine/raspberrypi.conf

SERIAL_CONSOLES ?= "115200;ttyAMA0"

PREFERRED_PROVIDER_virtual/kernel = "linux-raspberrypi"
```
